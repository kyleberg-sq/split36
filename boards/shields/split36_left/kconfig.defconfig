## boards/shields/split36_left/kconfig.defconfig
```kconfig
if SHIELD_SPLIT36_LEFT
config ZMK_KEYBOARD_NAME
    default "Split36 Left"
endif

if SHIELD_SPLIT36_RIGHT
config ZMK_KEYBOARD_NAME
    default "Split36 Right"
endif
```

## boards/shields/split36_right/kconfig.shield
```kconfig
config SHIELD_SPLIT36_LEFT
    bool "Split36 Left"
    select ZMK_KEYBOARD_SCAN
    select ZMK_MATRIX_TRANSFORM

config SHIELD_SPLIT36_RIGHT
    bool "Split36 Right"
    select ZMK_KEYBOARD_SCAN
    select ZMK_MATRIX_TRANSFORM
```
